/dts-v1/;
/plugin/;

/ {
    compatible = "brcm,bcm2711";

    fragment@0 {
        target = <&spi0>;
        __overlay__ {
            status = "okay";
            #address-cells = <1>;
            #size-cells = <0>;

            mcp3208: mcp3208@0 {
                compatible = "microchip,mcp3208";
                reg = <0>;
                spi-max-frequency = <100000>;
                // vref-supply = <&vref_reg>; // reference defined Vref
                spi-cpha;
                spi-cpol;
                #io-channel-cells = <1>;
            };
        };
    };
};
