/dts-v1/;
/plugin/;

/ {
    compatible = "brcm,bcm2835", "brcm,bcm2711", "brcm,bcm2837";

    fragment@0 {
        target = <&spi0>;
        __overlay__ {
            status = "okay";
            #address-cells = <1>;
            #size-cells = <0>;

            spidev@0 {
                status = "disabled";
			};

            mcp3208: mcp3208@0 {
                compatible = "microchip,mcp3208";
                reg = <0>;
                spi-max-frequency = <1000000>; /* 1 MHz */
                spi-cpha;
                spi-cpol;
                vref-supply = <&vcc_3v3>;
                #io-channel-cells = <1>;
            };
        };
    };

    __overrides__ {
        spi0 = <&spi0>;
    };
};