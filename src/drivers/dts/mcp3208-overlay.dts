/dts-v1/;
/plugin/;

/ {
	compatible = "brcm,bcm2835";

	fragment@0 {
		target = <&spi0>;
		__overlay__ {
			status = "okay";
			#address-cells = <1>;
			#size-cells = <0>;

			mcp3208: mcp3208@0 {
				compatible = "microchip,mcp3208";
				reg = <0>;
				spi-max-frequency = <1000000>; /* 1 MHz */
				spi-cpha;
				spi-cpol;
				#io-channel-cells = <1>;
			};
		};
	};


	fragment@1 {
		target = <&spi0>;
		__overlay__ {
			status = "okay";
			#address-cells = <1>;
			#size-cells = <0>;

			spidev@0 {
				compatible = "spidev";
				reg = <0x00>;
				status = "disabled";
			};
		};
	};

};